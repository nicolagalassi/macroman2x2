## boards/shields/macroman2x2/Kconfig.defconfig
```kconfig
# SPDX-License-Identifier: MIT

if SHIELD_MACROMAN2X2

config ZMK_KEYBOARD_NAME
    default "MacroMan 2x2"

endif
```

## boards/shields/macroman2x2/Kconfig.shield
```kconfig
# SPDX-License-Identifier: MIT

config SHIELD_MACROMAN2X2
    def_bool $(shields_list_contains,macroman2x2)
```
